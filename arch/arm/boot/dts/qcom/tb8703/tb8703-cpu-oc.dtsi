/* Copyright (c) 2020, The Linux Foundation. All rights reserved.
*  Copyright (c) 2020, Jebaitedneko.
*
* This program is free software; you can redistribute it and/or modify
* it under the terms of the GNU General Public License version 2 and
* only version 2 as published by the Free Software Foundation.
*
* This program is distributed in the hope that it will be useful,
* but WITHOUT ANY WARRANTY; without even the implied warranty of
* MERCHANTABILITY or FITNESS FOR A PARTICULAR PURPOSE.  See the
* GNU General Public License for more details.
*/

&CPU0 {
	clock-frequency = <3264000000>;
	efficiency = <1024>; // 1024
};
&CPU1 {
	clock-frequency = <3264000000>;
	efficiency = <1024>; // 1024
};
&CPU2 {
	clock-frequency = <3264000000>;
	efficiency = <1024>; // 1024
};
&CPU3{
	clock-frequency = <3264000000>;
	efficiency = <1024>; // 1024
};
&CPU4 {
	clock-frequency = <3264000000>;
	efficiency = <1228>; // 1126
};
&CPU5 {
	clock-frequency = <3264000000>;
	efficiency = <1228>; // 1126
};
&CPU6 {
	clock-frequency = <3264000000>;
	efficiency = <1228>; // 1126
};
&CPU7{
	clock-frequency = <3264000000>;
	efficiency = <1228>; // 1126
};

&msm_cpufreq {

	clock-names = "l2_clk", "cpu0_clk", "cpu1_clk",
				"cpu2_clk", "cpu3_clk", "cpu4_clk",
				"cpu5_clk", "cpu6_clk", "cpu7_clk",
				"cpu8_clk", "cpu9_clk", "cpu10_clk",
				"cpu11_clk", "cpu12_clk";

	clocks = <&clock_cpu clk_cci_clk>,
			<&clock_cpu clk_a53_pwr_clk>,
			<&clock_cpu clk_a53_pwr_clk>,
			<&clock_cpu clk_a53_pwr_clk>,
			<&clock_cpu clk_a53_pwr_clk>,
			<&clock_cpu clk_a53_pwr_clk>,
			<&clock_cpu clk_a53_pwr_clk>,
			<&clock_cpu clk_a53_pwr_clk>,
			<&clock_cpu clk_a53_pwr_clk>,
			<&clock_cpu clk_a53_pwr_clk>,
			<&clock_cpu clk_a53_pwr_clk>,
			<&clock_cpu clk_a53_pwr_clk>,
			<&clock_cpu clk_a53_pwr_clk>,
			<&clock_cpu clk_a53_pwr_clk>;

	qcom,cpufreq-table =
		<  435200 >,
		<  652800 >,
		<  870400 >,
		< 1088000 >,
		< 1305600 >,
		< 1523200 >,
		< 1740800 >,
		< 1958400 >,
		< 2176000 >,
		< 2393600 >,
		< 2611200 >,
		< 2828800 >,
		< 3046400 >,
		< 3264000 >;
};

&cpubw {

	qcom,bw-tbl =
		<   769 /*  100.8 MHz  */ >,
		<  1611 /*  211.2 MHz  */ >,
		<  2124 /*  278.4 MHz  */ >,
		<  2929 /*  384   MHz  */ >,
		<  3221 /*  422.4 MHz  */ >,
		<  4248 /*  556.8 MHz  */ >,
		<  5126 /*  672   MHz  */ >,
		<  5859 /*  768   MHz  */ >,
		<  6152 /*  806.4 MHz  */ >,
		<  6445 /*  844.8 MHz  */ >,
		<  7104 /*  931.2 MHz  */ >,
		<  7759 /*  1017.0 MHz */ >,
		<  9887 /*  1296.0 MHz */ >;
};

&mincpubw {

	qcom,bw-tbl =
		<   769 /*  100.8 MHz  */ >,
		<  1611 /*  211.2 MHz  */ >,
		<  2124 /*  278.4 MHz  */ >,
		<  2929 /*  384   MHz  */ >,
		<  3221 /*  422.4 MHz  */ >,
		<  4248 /*  556.8 MHz  */ >,
		<  5126 /*  672   MHz  */ >,
		<  5859 /*  768   MHz  */ >,
		<  6152 /*  806.4 MHz  */ >,
		<  6445 /*  844.8 MHz  */ >,
		<  7104 /*  931.2 MHz  */ >,
		<  7759 /*  1017.0 MHz */ >,
		<  9887 /*  1296.0 MHz */ >;
};

&soc {

	devfreq-cpufreq {

		cpubw-cpufreq {

			cpu-to-dev-map =
				<  435200 6152>,
				<  652800 6152>,
				<  870400 6152>,
				< 1088000 7104>,
				< 1305600 7104>,
				< 1523200 7104>,
				< 1740800 7759>,
				< 1958400 7759>,
				< 2176000 7759>,
				< 2393600 9887>,
				< 2611200 9887>,
				< 2828800 9887>,
				< 3046400 9887>,
				< 3264000 9887>;
		};

		mincpubw-cpufreq {

			cpu-to-dev-map =
				<  435200 1611>,
				<  652800 1611>,
				<  870400 1611>,
				< 1088000 3221>,
				< 1305600 3221>,
				< 1523200 3221>,
				< 1740800 4248>,
				< 1958400 4248>,
				< 2176000 4248>,
				< 2393600 6445>,
				< 2611200 6445>,
				< 2828800 6445>,
				< 3046400 6445>,
				< 3264000 6445>;
		};
	};
};

&cpubw_compute {

	qcom,core-dev-table =
		<  435200 6152>,
		<  652800 6152>,
		<  870400 6152>,
		< 1088000 7104>,
		< 1305600 7104>,
		< 1523200 7104>,
		< 1740800 7759>,
		< 1958400 7759>,
		< 2176000 7759>,
		< 2393600 9887>,
		< 2611200 9887>,
		< 2828800 9887>,
		< 3046400 9887>,
		< 3264000 9887>;
};

&mincpubw_compute {

	qcom,core-dev-table =
		<  435200 1611>,
		<  652800 1611>,
		<  870400 1611>,
		< 1088000 3221>,
		< 1305600 3221>,
		< 1523200 3221>,
		< 1740800 4248>,
		< 1958400 4248>,
		< 2176000 4248>,
		< 2393600 6445>,
		< 2611200 6445>,
		< 2828800 6445>,
		< 3046400 6445>,
		< 3264000 6445>;
};

&clock_cpu {
	qcom,speed7-bin-v0-cl =
		<          0 0>,
		<  435200000 1>,  // 4352 x 1.0
		<  652800000 2>,  // 4352 x 1.5
		<  870400000 3>,  // 4352 x 2.0
		< 1088000000 4>,  // 4352 x 2.5
		< 1305600000 5>,  // 4352 x 3.0
		< 1523200000 6>,  // 4352 x 3.5
		< 1740800000 7>,  // 4352 x 4.0
		< 1958400000 8>,  // 4352 x 4.5
		< 2176000000 9>,  // 4352 x 5.0
		< 2393600000 10>, // 4352 x 5.5
		< 2611200000 11>, // 4352 x 6.0
		< 2828800000 12>, // 4352 x 6.5
		< 3046400000 13>, // 4352 x 7.0
		< 3264000000 14>; // 4352 x 7.5
	qcom,speed7-bin-v0-cci =
		<          0 0>,
		<  174080000 1>,   //  435200000 / 2.5
		<  261120000 2>,   //  652800000 / 2.5
		<  348160000 3>,   //  870400000 / 2.5
		<  435200000 4>,   // 1
